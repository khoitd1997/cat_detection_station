/dts-v1/;
/plugin/;

/ {
        compatible = "brcm,bcm2835", "brcm,bcm2710";

        fragment@0 {
                target = <&i2c1>;
                __overlay__ {
                        #address-cells = <1>;
                        #size-cells = <0>;
                        status = "okay";

                        bmp280_kd@77 {
                                compatible = "bosch,bmp280_kd";
                                reg = <0x77>; // i2c address
                                status = "okay";
                        };
                };
        };
};