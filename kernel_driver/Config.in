## kernel_driver/Config.in
```kconfig
source "$BR2_EXTERNAL_KD_BR2_PATH/bmp280_kd/Config.in"
source "$BR2_EXTERNAL_KD_BR2_PATH/htu21d_kd/Config.in"
```

## kernel_driver/bmp280_kd/Config.in
```kconfig
config BR2_PACKAGE_BMP280_KD
        bool "bmp280_kd"
        depends on BR2_LINUX_KERNEL
        help 
            BMP280 kernel module written by Khoi Trinh.
```

## kernel_driver/htu21d_kd/Config.in
```kconfig
config BR2_PACKAGE_HTU21D_KD
        bool "htu21d_kd"
        depends on BR2_LINUX_KERNEL
        help 
            htu21d kernel module written by Khoi Trinh.
```
