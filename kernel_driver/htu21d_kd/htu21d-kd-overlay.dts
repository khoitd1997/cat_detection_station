
/dts-v1/;
/plugin/;

/ {
        compatible = "brcm,bcm2835","brcm,bcm2710";

        fragment@0 {
                target = <&i2c_arm>;
                __overlay__ {
                        #address-cells = <1>;
                        #size-cells = <0>;
                        status = "okay";

                        htu21d_kd@40 {
                                compatible = "bosch,htu21d_kd";
                                reg = <0x40>; // i2c address
                                status = "okay";
                        };
                };
        };
};